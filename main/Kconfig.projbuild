## main/Kconfig.projbuild
```kconfig
menu "Application Configuration"

	config GPIO_OUTPUT
		int "GPIO output pin"
		range 0 SOC_GPIO_OUT_RANGE_MAX
		help
			GPIO pin number to be used as GPIO_OUTPUT_IO.

	config GPIO_INPUT
		int "GPIO input pin"
		range 0 SOC_GPIO_IN_RANGE_MAX
		help
			GPIO pin number to be used as GPIO_INPUT_IO.

	config SUB_STRING1
		string "SUB_STRING1"
		default "$(substring,"foobar",0,3)"

	config SUB_STRING2
		string "SUB_STRING2"
		default "$(substring,"foobar",3)"

endmenu
```
